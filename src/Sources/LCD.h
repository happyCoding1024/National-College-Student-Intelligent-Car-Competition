#include <hidef.h>      /* common defines and macros */
#include <MC9S12XS128.h>     /* derivative information */
//ragma LINK_INFO DERIVATIVE "mc9s12xs128"
#define uchar unsigned char
#define uint unsigned int
void LCD_clear(void);
/*
sbit    sce = PORTB_PB2;  //片选
sbit    res = PORTB_PB0;  //复位,0复位
sbit    dc  = PORTB_PB1;  //1写数据，0写指令
sbit    sdin = PORTB_PB3;  //数据
sbit    sclk = PORTB_PB4;  //时钟
*/
unsigned int font6x8[][6] =
{
    { 0x00, 0x00, 0x00, 0x00, 0x00, 0x00 },   // sp      00
    { 0x00, 0x00, 0x00, 0x2f, 0x00, 0x00 },   // !       01
    { 0x00, 0x00, 0x07, 0x00, 0x07, 0x00 },   // "       02
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    { 0x14, 0x14, 0x14, 0x14, 0x14, 0x14 }    // horiz lines
};


const unsigned char F14x16_Idx[] = 
{
  "智能车液晶室温度按键次电压大气二"
};
const unsigned char F14x16[] = 
{  
  0x14,0x13,0x92,0x7E,0x32,0x52,0x92,0x00,0x7C,0x44,0x44,0x44,0x7C,0x00,
  0x01,0x01,0x00,0xFF,0x49,0x49,0x49,0x49,0x49,0x49,0xFF,0x00,0x00,0x00,//智
  0xB8,0x97,0x92,0x90,0x94,0xB8,0x10,0x00,0x7F,0x48,0x48,0x44,0x74,0x20,
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  0x00,0x20,0x20,0x20,0x20,0x20,0x20,0x20,0x20,0x20,0x20,0x10,0x10,0x00,//二

};


void delay_1ms(void)//1ms延时函数
{
	unsigned int i;
	for (i=0;i<600;i++)	  ;

}
void delay_nms(unsigned int n)       //N ms延时函数
  {
   unsigned int i=0;
   for (i=0;i<n;i++)
   delay_1ms();
  }
/*--------------------------------------------
LCD_write_byte: 使用SPI接口写数据到LCD
输入参数：dt：写入的数据；
command ：写数据/命令选择；
编写日期：20080918 
----------------------------------------------*/
void LCD_write_byte(unsigned char dt, unsigned char command)
{
	unsigned char i; 
	PORTA_PA0=0;	 //sce
	if(command==0)
	PORTA_PA2=0;//dc
	else 
		PORTA_PA2=1;//dc	
	for(i=0;i<8;i++)
	{ 
		if(dt&0x80)
			PORTA_PA3=1;//sdin
		else
			PORTA_PA3=0; //sdin
		dt=dt<<1;		
		PORTA_PA4=0; //sclk 		
		PORTA_PA4=1; //sclk
	}	
//	PORTB_PB5=1;//dc	
	PORTA_PA1=1;//sce	
//	PORTB_PB4=1;//sdin
}
/*---------------------------------------
LCD_init: 3310LCD初始化
编写日期：20080918 
-----------------------------------------  */
void LCD_init(void)
{
	PORTA_PA1=0;  //res	
  	delay_1ms();
 	PORTA_PA1=1; //res
 		PORTA_PA0=0;  //CE	
  	delay_1ms();
 	PORTA_PA0=1; //CE
 	  delay_1ms();
	LCD_write_byte(0x21,0);//初始化Lcd,功能设定使用扩充指令
	LCD_write_byte(0xC8,0);//设定液晶偏置电压
	LCD_write_byte(0x20,0);//使用基本指令
//	LCD_write_byte(0x0C,0);//设定显示模式，正常显示
	LCD_write_byte(0x13,0);
	LCD_write_byte(0x06,0);
	LCD_clear() ;
 LCD_write_byte(0x0C,0);//设定显示模式，正常显示
  PORTA_PA0=0;  //CE	
	
}
/*-------------------------------------------
LCD_set_XY: 设置LCD坐标函数
输入参数：X：0－83  Y：0－5
编写日期：20080918 
---------------------------------------------*/
void LCD_set_XY(unsigned char X, unsigned char Y)
{
	LCD_write_byte(0x40 | Y, 0);// column
	LCD_write_byte(0x80 | X, 0);// row
} 
/*------------------------------------------
LCD_clear: LCD清屏函数
编写日期：20080918 
--------------------------------------------*/
void LCD_clear(void)
{
   	unsigned int i;
    LCD_write_byte(0x0c, 0);			
    LCD_write_byte(0x80, 0);	
    for (i=0; i<504; i++)
    LCD_write_byte(0, 1); 
}
/*---------------------------------------------
LCD_write_shu: 显示6（宽）*12（高）点阵列数字字母符号等半角类
输入参数：c：显示的字符；
编写日期：20080918 
-----------------------------------------------*/
void LCD_write_shu(unsigned int X,unsigned int Y,unsigned int num,unsigned int N) //row:列 page:页 dd:字符
{
unsigned int line;
  unsigned int i=0;
  unsigned int n[6]={0};
  n[0]= num%10;
  n[1]=(num/10)%10;
  n[2]=(num/100)%10;
  n[3]=(num/1000)%10;
  n[4]=(num/10000)%10;
  n[5]=(num/100000)%10;
  for(i=0;i<6;i++) n[i]=n[i]+16;
  for(i=N;i>0;i--) 
  {

    LCD_set_XY(X+(N-i)*6,Y);//光标定位
    for (line=0; line<6; line++)
    LCD_write_byte(font6x8[n[i-1]][line], 1);//从ACSII码表中读取字节，然后写入液晶
  }
		 	
}   
//--------------------------------------------------------------------------
void LCD_P6x8Str(unsigned char x,unsigned char y,unsigned char ch[])
{
	unsigned char c=0,i=0,j=0;
	while (ch[j]!='\0')
	{
		c =(unsigned char)(ch[j]-32);
		if(x>126)
		{
			x=0;
			y++;
		}
		LCD_set_XY(x,y);
		for(i=0;i<6;i++)
			LCD_write_byte(font6x8[c][i],1);
		x+=6;
		j++;
	}
}
//==============================================================
//函数名：LCD_P14x16Str(unsigned char x,unsigned char y,unsigned char ch[])
//功能描述：输出汉字字符串没有添加到库里的显示为空
//参数：显示的位置（x,y），y为页范围0～7，要显示的字符串
//返回：无
//==============================================================  
void LCD_P14x16Str(unsigned char x,unsigned char y,unsigned char ch[])
{
  unsigned char wm=0,ii = 0;
  unsigned int adder=1; 
	
  while(ch[ii] != '\0')
  {
    wm = 0;
    adder = 1;
    while(F14x16_Idx[wm] > 127)
    {
      if(F14x16_Idx[wm] == ch[ii])
      {
        if(F14x16_Idx[wm + 1] == ch[ii + 1])
        {
          adder = wm * 14;break;
        }
      }
      wm += 2;
    }
    if(x>118)
    {
      x=0;
      y++;
    }
		
    LCD_set_XY(x , y);
    if(adder != 1)// 显示汉字
    {
      LCD_set_XY(x , y);
      for(wm = 0;wm < 14;wm++)
      {
        LCD_write_byte(F14x16[adder],1);
        adder += 1;
      }
      LCD_set_XY(x,(unsigned char)(y+1));
      for(wm = 0;wm < 14;wm++)
      {
        LCD_write_byte(F14x16[adder],1);
        adder += 1;
      }
    }
    else			  //显示空白字符
    {
      ii += 1;
      LCD_set_XY(x,y);
      for(wm = 0;wm < 16;wm++)
      {
        LCD_write_byte(0,1);
      }
      LCD_set_XY(x,(unsigned char)(y+1));
      for(wm = 0;wm < 16;wm++)
      {
        LCD_write_byte(0,1);
      }
    }
    x += 14;
    ii += 2;
  }
}
/*---------------------------------------------
LCD_write_hanzi: 显示16（宽）*16（高）点阵列汉字等半角类
输入参数：c：显示的字符；
编写日期：20080918 
----------------------------------------------*/
/*
void LCD_write_hanzi(unsigned char row, unsigned char page,unsigned char c) //row:列 page:页 dd:字符
{
	unsigned char i;  	
	
	LCD_set_XY(row*3, page);// 列，页 
	for(i=0; i<16;i++) 
	{
		LCD_write_byte(hanzi[c*32+i],1); 
	}
	
    LCD_set_XY(row*3, page+1);// 列，页 
	for(i=16; i<32;i++) 
	{
		LCD_write_byte(hanzi[c*32+i],1);
	}	
} 
*/